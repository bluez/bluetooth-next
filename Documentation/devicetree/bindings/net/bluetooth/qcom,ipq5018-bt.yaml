## Documentation/devicetree/bindings/net/bluetooth/qcom,ipq5018-bt.yaml
```yaml
# SPDX-License-Identifier: (GPL-2.0 OR BSD-2-Clause)
%YAML 1.2
---
$id: http://devicetree.org/schemas/net/bluetooth/qcom,ipq5018-bt.yaml#
$schema: http://devicetree.org/meta-schemas/core.yaml#

title: Qualcomm IPQ5018 Bluetooth

maintainers:
  - George Moussalem <george.moussalem@outlook.com>

properties:
  compatible:
    enum:
      - qcom,ipq5018-bt

  clocks:
    items:
      - description: Bluetooth Subsystem low power oscillator clock

  clock-names:
    items:
      - const: lpo

  firmware-name:
    maxItems: 1

  memory-region:
    items:
      - description: |
          Reserved memory carveout for firmware loading and runtime data
          transport between the host and the Bluetooth controller.

  interrupts:
    maxItems: 1

  qcom,ipc:
    $ref: /schemas/types.yaml#/definitions/phandle-array
    items:
      - items:
          - description: syscon node representing the APCS registers
          - description: offset to the register within the syscon
          - description: IPC bit within the register
    description: |
      The outgoing IPC bit used for signaling the Bluetooth controller of a host
      event or for sending an ACK if the remote processor expects it.

  resets:
    items:
      - description: Bluetooth Subsystem reset

required:
  - compatible
  - clocks
  - clock-names
  - firmware-name
  - interrupts
  - qcom,ipc
  - resets

allOf:
  - $ref: bluetooth-controller.yaml#
  - $ref: qcom,bluetooth-common.yaml

unevaluatedProperties: false

examples:
  - |
    #include <dt-bindings/clock/qcom,gcc-ipq5018.h>
    #include <dt-bindings/interrupt-controller/arm-gic.h>
    #include <dt-bindings/reset/qcom,gcc-ipq5018.h>

    bluetooth {
      compatible = "qcom,ipq5018-bt";

      firmware-name = "qca/bt_fw_patch.mbn";

      clocks = <&gcc GCC_BTSS_LPO_CLK>;
      clock-names = "lpo";
      resets = <&gcc GCC_BTSS_BCR>;

      qcom,ipc = <&apcs_glb 8 23>;
      interrupts = <GIC_SPI 162 IRQ_TYPE_EDGE_RISING>;

      memory-region = <&btss_region>;
    };
```

## Documentation/devicetree/bindings/remoteproc/qcom,m0-btss-pil.yaml
```yaml
# SPDX-License-Identifier: (GPL-2.0-only OR BSD-2-Clause)
%YAML 1.2
---
$id: http://devicetree.org/schemas/remoteproc/qcom,m0-btss-pil.yaml#
$schema: http://devicetree.org/meta-schemas/core.yaml#

title: Qualcomm M0 BTSS Peripheral Image Loader

maintainers:
  - George Moussalem <george.moussalem@outlook.com>

description:
  Qualcomm M0 BTSS Peripheral Secure Image Loader loads firmware and powers up
  the M0 BTSS remote processor core on the Qualcomm IPQ5018 SoC.

properties:
  compatible:
    enum:
      - qcom,ipq5018-btss-pil

  firmware-name:
    maxItems: 1
    description: Firmware name for the M0 Bluetooth Subsystem core

  clocks:
    items:
      - description: M0 BTSS low power oscillator clock

  clock-names:
    items:
      - const: btss_lpo_clk

  memory-region:
    items:
      - description: M0 BTSS reserved memory carveout

  resets:
    items:
      - description: M0 BTSS reset

  reset-names:
    items:
      - const: btss_reset

required:
  - compatible
  - firmware-name
  - clocks
  - clock-names
  - resets
  - reset-names
  - memory-region

additionalProperties: false

examples:
  - |
    #include <dt-bindings/clock/qcom,gcc-ipq5018.h>
    #include <dt-bindings/reset/qcom,gcc-ipq5018.h>

    remoteproc {
      compatible = "qcom,ipq5018-btss-pil";

      firmware-name = "qca/bt_fw_patch.mbn";

      clocks = <&gcc GCC_BTSS_LPO_CLK>;
      clock-names = "btss_lpo_clk";
      resets = <&gcc GCC_BTSS_BCR>;
      reset-names = "btss_reset";

      memory-region = <&btss_region>;
    };
```
